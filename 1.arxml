AUTOSAR XML (schema 00048)
package /ActiveEcuC
  module config Com: implementation-config-variant=VARIANT-PRE-COMPILE, module-description=Com_Impl
    ComGeneration:
      ComOutOfBoundsWriteProtectionStrategy = NONE
      ComOutOfBoundsWriteSanitizer = false
      ComOutOfBoundsReadSanitizer = false
      ComReduceConstantData2Define = true
      ComBoolDataInArrayOfStructStrategy = BOOLEAN
      ComDeduplicateIndirectedData = true
      ComDataDeduplicationStrategy = WITH_CAST
      ComReduceBoolDataByNegationThreshold = 0
      ComReduceBoolDataByNumericalComparisonThreshold = 0
      ComReduceBoolDataByNumericalRelationThreshold = 0
      ComReduceBoolDataByNumericalOperandStrategy = NONE
      ComReduceNumericalDataByOffsetThreshold = 0
      ComReduceNumericalDataByArraySubtractionThreshold = 0
      ComReduceDataByStreaming = false
      ComShortSymbols = false
      ComInterfacesForDeactivatedData = false
      ComReferringKeysInComments = true
    ComOptimization:
      ComTxProcessingISRLockThreshold = 20
      ComRxProcessingISRLockThreshold = 20
      ComGatewayProcessingISRLockThreshold = 0
      ComGatewayDescriptionProcessingISRLockThreshold = 0
      ComIPduGroupISRLockThreshold = 20
    ComConfig: ComConfigurationId=0, ComRxDeferredNotificationCacheSize=0, ComRxImmediateNotificationCacheSize=0
      ComMainFunctionRx: ComMainRxTimeBase=0.005
      ComMainFunctionTx: ComMainTxTimeBase=0.005
      ComMainFunctionRouteSignals: ComMainRouteSignalsTimeBase=0.01
      EPS_oCAN00_Tx_6df63845 (ComIPduGroup): ComIPduGroupHandleId=1
      EPS_oCAN00_Rx_3bac9fc3 (ComIPduGroup): ComIPduGroupHandleId=0
      9 x ComIPdu, all with ComIPduType=NORMAL, ComIPduSignalProcessing=DEFERRED, ComIPduCancellationSupport=false:
        EPAS_INFO_oCAN00_6cc9ab9f_Tx: ComIPduDirection=SEND, ComIPduHandleId=0, ComIPduGroupRef=EPS_oCAN00_Tx_6df63845, ComIPduSignalRef=FV_EPAS_Failure_oEPAS_INFO_oCAN00_97b9f280_Tx, ComIPduSignalRef=FV_SAPPAngleControlStat1_oEPAS_INFO_oCAN00_03f75693_Tx, ComIPduSignalRef=FV_SAPPAngleControlStat2_oEPAS_INFO_oCAN00_a0a1d03a_Tx, ComIPduSignalRef=FV_SAPPAngleControlStat3_oEPAS_INFO_oCAN00_77435062_Tx, ComIPduSignalRef=FV_SAPPAngleControlStat4_oEPAS_INFO_oCAN00_3d7ddb29_Tx, ComIPduSignalRef=FV_SAPPAngleControlStat5_oEPAS_INFO_oCAN00_ea9f5b71_Tx, ComIPduSignalRef=FV_SAPPAngleControlStat6_oEPAS_INFO_oCAN00_49c9ddd8_Tx, ComIPduSignalRef=FV_SteMdule_D_Stat_oEPAS_INFO_oCAN00_d560c704_Tx, ComIPduSignalRef=FV_SteMdule_I_Est_oEPAS_INFO_oCAN00_b5bdb270_Tx, ComIPduSignalRef=FV_SteMdule_U_Meas_oEPAS_INFO_oCAN00_d76bf1e6_Tx, ComIPduSignalRef=FV_SteeringColumnTorque_oEPAS_INFO_oCAN00_c7fbe189_Tx, ComIPduSignalRef=FV_TrlrHitchLamp_D_Rqst_oEPAS_INFO_oCAN00_5ad48b42_Tx, ComIPduSignalRef=FV_VehVTrlrAid_B_Rq_oEPAS_INFO_oCAN00_6b55d9a4_Tx, ComIPduSignalRef=FV_Veh_V_RqMxTrlrAid_oEPAS_INFO_oCAN00_68afc19f_Tx, ComIPduSignalRef=SteEffort_D_Stat_oEPAS_INFO_oCAN00_46a7a24d_Tx, ComPduIdRef=EPAS_INFO_oCAN00_6cc9ab9f_Tx, ComIPduMainFunctionRef=ComMainFunctionTx
          ComTxIPdu: ComMinimumDelayTime=0, ComTxIPduUnusedAreasDefault=0
            ComTxModeTrue
              ComTxMode: ComTxModeMode=PERIODIC, ComTxModeTimeOffset=0, ComTxModeTimePeriod=0.02
            ComTxModeFalse
              ComTxMode: ComTxModeMode=PERIODIC, ComTxModeTimeOffset=0, ComTxModeTimePeriod=0.02
        TrlrAid_D2_oCAN00_34ed0064_Tx: ComIPduDirection=SEND, ComIPduHandleId=4, ComIPduGroupRef=EPS_oCAN00_Tx_6df63845, ComIPduSignalRef=FV_EsaOn_B_Stat_oTrlrAid_D2_oCAN00_2d70d956_Tx, ComIPduSignalRef=FV_HitchToTrlrAxle_L_Calc_oTrlrAid_D2_oCAN00_1bfa249a_Tx, ComIPduSignalRef=FV_SelDrvMdeSte_D_Stat_oTrlrAid_D2_oCAN00_732052ec_Tx, ComIPduSignalRef=FV_TrlrAidEnbl_D2_Stat_oTrlrAid_D2_oCAN00_a9fbcff0_Tx, ComIPduSignalRef=FV_TrlrAidMsgTxt_D2_Rq_oTrlrAid_D2_oCAN00_9026eb20_Tx, ComIPduSignalRef=FV_TrlrAidSetup_D2_Stat_oTrlrAid_D2_oCAN00_faf4f004_Tx, ComIPduSignalRef=FV_TrlrAidTrgtId_No_Rq_oTrlrAid_D2_oCAN00_bf0452ab_Tx, ComIPduSignalRef=FV_TrlrAidTrlrId_No_Rq_oTrlrAid_D2_oCAN00_b16cf22b_Tx, ComIPduSignalRef=FV_TrlrAnOffst_An2_Calc_oTrlrAid_D2_oCAN00_a28765f2_Tx, ComIPduSignalRef=FV_TrlrAn_An_MxCalc_oTrlrAid_D2_oCAN00_27a34d68_Tx, ComIPduSignalRef=FV_TrlrAn_An_WarnCalc_oTrlrAid_D2_oCAN00_ce1f32c3_Tx, ComPduIdRef=TrlrAid_D2_oCAN00_34ed0064_Tx, ComIPduMainFunctionRef=ComMainFunctionTx
          ComTxIPdu: ComMinimumDelayTime=0, ComTxIPduUnusedAreasDefault=0
            ComTxModeTrue
              ComTxMode: ComTxModeMode=PERIODIC, ComTxModeTimeOffset=0, ComTxModeTimePeriod=1
            ComTxModeFalse
              ComTxMode: ComTxModeMode=PERIODIC, ComTxModeTimeOffset=0, ComTxModeTimePeriod=1
        StrgPn_D_oCAN00_6f030d2e_Tx: ComIPduDirection=SEND, ComIPduHandleId=2, ComIPduGroupRef=EPS_oCAN00_Tx_6df63845, ComIPduSignalRef=StePinAn_No_Cnt_oStrgPn_D_oCAN00_91969038_Tx, ComIPduSignalRef=StePinAn_No_Cs_oStrgPn_D_oCAN00_4581731e_Tx, ComIPduSignalRef=StePinCompAnEst_D_Qf_oStrgPn_D_oCAN00_8c4413a4_Tx, ComIPduSignalRef=StePinComp_An_Est_oStrgPn_D_oCAN00_b8d3bdc9_Tx, ComIPduSignalRef=StePinRelInit_An_Sns_oStrgPn_D_oCAN00_c643371e_Tx, ComPduIdRef=StrgPn_D_oCAN00_6f030d2e_Tx, ComIPduMainFunctionRef=ComMainFunctionTx
          ComTxIPdu: ComMinimumDelayTime=0, ComTxIPduUnusedAreasDefault=0
            ComTxModeTrue
              ComTxMode: ComTxModeMode=PERIODIC, ComTxModeTimeOffset=0, ComTxModeTimePeriod=0.01
            ComTxModeFalse
              ComTxMode: ComTxModeMode=PERIODIC, ComTxModeTimeOffset=0, ComTxModeTimePeriod=0.01
        LAst_D3_oCAN00_2e3ab7d5_Tx: ComIPduDirection=SEND, ComIPduHandleId=1, ComIPduGroupRef=EPS_oCAN00_Tx_6df63845, ComIPduSignalRef=FV_LaActAvail_D2_Actl_oLAst_D3_oCAN00_f97f1300_Tx, ComIPduSignalRef=FV_LaActDeny_B_Actl_oLAst_D3_oCAN00_0e7c7fb2_Tx, ComIPduSignalRef=FV_LaHandsOff_B_Actl_oLAst_D3_oCAN00_684e7061_Tx, ComIPduSignalRef=FV_LatCtlCpbltyDStat_No_Cnt_oLAst_D3_oCAN00_560d175e_Tx, ComIPduSignalRef=FV_LatCtlCpbltyDStat_No_Cs_oLAst_D3_oCAN00_711cc2cd_Tx, ComIPduSignalRef=FV_LatCtlCpblty_D_Stat_oLAst_D3_oCAN00_259a7af1_Tx, ComIPduSignalRef=FV_LatCtlLim_D_Stat_oLAst_D3_oCAN00_256132d3_Tx, ComIPduSignalRef=FV_LatCtlSte_D_Stat_oLAst_D3_oCAN00_fafe6da3_Tx, ComIPduSignalRef=FV_LsmcBrkDecelEnbl_D_Rq_oLAst_D3_oCAN00_caa26530_Tx, ComIPduSignalRef=FV_LsmcBrk_Tq_Rq_oLAst_D3_oCAN00_43eaaa75_Tx, ComIPduSignalRef=FV_TjaHandsOnCnfdnc_B_Est_oLAst_D3_oCAN00_43e38363_Tx, ComIPduSignalRef=FV_TrlrAn_An_TrgtCalc_oLAst_D3_oCAN00_899ff7ff_Tx, ComPduIdRef=LAst_D3_oCAN00_2e3ab7d5_Tx, ComIPduMainFunctionRef=ComMainFunctionTx
          ComTxIPdu: ComMinimumDelayTime=0, ComTxIPduUnusedAreasDefault=0
            ComTxModeTrue
              ComTxMode: ComTxModeMode=PERIODIC, ComTxModeTimeOffset=0, ComTxModeTimePeriod=0.03
            ComTxModeFalse
              ComTxMode: ComTxModeMode=PERIODIC, ComTxModeTimeOffset=0, ComTxModeTimePeriod=0.03
        Accel_Data_oCAN00_c2d23e6f_Rx: ComIPduDirection=RECEIVE, ComIPduHandleId=0, ComIPduGroupRef=EPS_oCAN00_Rx_3bac9fc3, ComIPduSignalRef=FV_VehLat2_A_Actl_oAccel_Data_oCAN00_8d12d287_Rx, ComIPduSignalRef=FV_VehLatAActl_D_Qf_oAccel_Data_oCAN00_6babd333_Rx, ComIPduSignalRef=FV_VehLatLongVertA_No_Cs_oAccel_Data_oCAN00_91d68ae9_Rx, ComIPduSignalRef=FV_VehLatLongVert_No_Cnt_oAccel_Data_oCAN00_42c3752c_Rx, ComIPduSignalRef=FV_VehLong2_A_Actl_oAccel_Data_oCAN00_84393ab1_Rx, ComIPduSignalRef=FV_VehLongAActl_D_Qf_oAccel_Data_oCAN00_4c662127_Rx, ComIPduSignalRef=FV_VehVert2_A_Actl_oAccel_Data_oCAN00_26fb041b_Rx, ComIPduSignalRef=FV_VehVertAActl_D_Qf_oAccel_Data_oCAN00_d9efca2d_Rx, ComPduIdRef=Accel_Data_oCAN00_c2d23e6f_Rx, ComIPduMainFunctionRef=ComMainFunctionRx
        BrkSysFtr_oCAN00_9e31fd2a_Rx: ComIPduDirection=RECEIVE, ComIPduHandleId=1, ComIPduGroupRef=EPS_oCAN00_Rx_3bac9fc3, ComIPduSignalRef=FV_VehVActlBrk_D_Qf_oBrkSysFtr_oCAN00_23a5d28a_Rx, ComIPduSignalRef=FV_VehVActlBrk_No_Cnt_oBrkSysFtr_oCAN00_d8f8c8c9_Rx, ComIPduSignalRef=FV_VehVActlBrk_No_Cs_oBrkSysFtr_oCAN00_e6dc4841_Rx, ComIPduSignalRef=FV_Veh_V_ActlBrk_oBrkSysFtr_oCAN00_ec1237cc_Rx, ComPduIdRef=BrkSysFtr_oCAN00_9e31fd2a_Rx, ComIPduMainFunctionRef=ComMainFunctionRx
        WheelSpeed_FD3_oCAN00_aaec1e09_Rx: ComIPduDirection=RECEIVE, ComIPduHandleId=3, ComIPduGroupRef=EPS_oCAN00_Rx_3bac9fc3, ComIPduSignalRef=FV_WhlFl_W_Meas_oWheelSpeed_FD3_oCAN00_0e731a53_Rx, ComIPduSignalRef=FV_WhlFr_W_Meas_oWheelSpeed_FD3_oCAN00_b162a32d_Rx, ComIPduSignalRef=FV_WhlRl_W_Meas_oWheelSpeed_FD3_oCAN00_62a06e90_Rx, ComIPduSignalRef=FV_WhlRr_W_Meas_oWheelSpeed_FD3_oCAN00_ddb1d7ee_Rx, ComPduIdRef=WheelSpeed_FD3_oCAN00_aaec1e09_Rx, ComIPduMainFunctionRef=ComMainFunctionRx
        EAC_Request_oCAN00_e1fd5765_Rx: ComIPduDirection=RECEIVE, ComIPduHandleId=2, ComIPduGroupRef=EPS_oCAN00_Rx_3bac9fc3, ComIPduSignalRef=FV_EAC_AngleRequestEnable_oEAC_Request_oCAN00_fccf3f58_Rx, ComIPduSignalRef=FV_EAC_AngleRequest_oEAC_Request_oCAN00_77e91227_Rx, ComIPduSignalRef=FV_EAC_CANValid_oEAC_Request_oCAN00_83d58ed2_Rx, ComPduIdRef=EAC_Request_oCAN00_e1fd5765_Rx, ComIPduMainFunctionRef=ComMainFunctionRx
        TM_oCAN00_c9627fef_Tx: ComIPduDirection=SEND, ComIPduHandleId=3, ComIPduGroupRef=EPS_oCAN00_Tx_6df63845, ComIPduSignalRef=TS1_oTM_oCAN00_d842ed65_Tx, ComIPduSignalRef=TS2_oTM_oCAN00_afdc3f95_Tx, ComIPduSignalRef=TS3_oTM_oCAN00_347973fa_Tx, ComIPduSignalRef=TS4_oTM_oCAN00_40e19a75_Tx, ComPduIdRef=TM_oCAN00_c9627fef_Tx, ComIPduMainFunctionRef=ComMainFunctionTx
          ComTxIPdu: ComMinimumDelayTime=0, ComTxIPduUnusedAreasDefault=0
            ComTxModeTrue
              ComTxMode: ComTxModeMode=PERIODIC, ComTxModeTimeOffset=0, ComTxModeTimePeriod=0.1
            ComTxModeFalse
              ComTxMode: ComTxModeMode=PERIODIC, ComTxModeTimeOffset=0, ComTxModeTimePeriod=0.1
      105 x ComSignal:
        FV_Veh_V_ActlBrk: ComBitPosition=7, ComBitSize=16, ComSignalEndianness=BIG_ENDIAN, ComSignalInitValue=0, ComSignalAccess=ACCESS_NEEDED_BY_SWC_OR_COM, ComSignalType=UINT16, ComHandleId=14, ComSystemTemplateSystemSignalRef=FV_Veh_V_ActlBrk
        FV_SteMdule_U_Meas: ComBitPosition=39, ComBitSize=8, ComSignalEndianness=BIG_ENDIAN, ComSignalInitValue=0, ComTransferProperty=PENDING, ComSignalAccess=ACCESS_NEEDED_BY_SWC_OR_COM, ComSignalType=UINT8, ComHandleId=22, ComSystemTemplateSystemSignalRef=FV_SteMdule_U_Meas
        TS4: ComBitPosition=40, ComBitSize=8, ComSignalEndianness=LITTLE_ENDIAN, ComSignalInitValue=0, ComSignalType=SINT8, ComTimeout=0, ComTransferProperty=PENDING, ComSignalAccess=ACCESS_NEEDED_BY_SWC_OR_COM, ComHandleId=46, ComSystemTemplateSystemSignalRef=TS4
        FV_TrlrAnOffst_An2_Calc: ComBitPosition=39, ComBitSize=8, ComSignalEndianness=BIG_ENDIAN, ComSignalInitValue=0, ComTransferProperty=PENDING, ComSignalAccess=ACCESS_NEEDED_BY_SWC_OR_COM, ComSignalType=UINT8, ComHandleId=30, ComSystemTemplateSystemSignalRef=FV_TrlrAnOffst_An2_Calc
        FV_TrlrAidEnbl_D2_Stat: ComBitPosition=31, ComBitSize=3, ComSignalEndianness=BIG_ENDIAN, ComSignalInitValue=0, ComTransferProperty=PENDING, ComSignalAccess=ACCESS_NEEDED_BY_SWC_OR_COM, ComSignalType=UINT8, ComHandleId=25, ComSystemTemplateSystemSignalRef=FV_TrlrAidEnbl_D2_Stat
        FV_VehVertAActl_D_Qf: ComBitPosition=38, ComBitSize=2, ComSignalEndianness=BIG_ENDIAN, ComSignalInitValue=0, ComSignalAccess=ACCESS_NEEDED_BY_SWC_OR_COM, ComSignalType=UINT8, ComHandleId=13, ComSystemTemplateSystemSignalRef=FV_VehVertAActl_D_Qf
        FV_SelDrvMdeSte_D_Stat: ComBitPosition=17, ComBitSize=2, ComSignalEndianness=BIG_ENDIAN, ComSignalInitValue=0, ComTransferProperty=PENDING, ComSignalAccess=ACCESS_NEEDED_BY_SWC_OR_COM, ComSignalType=UINT8, ComHandleId=19, ComSystemTemplateSystemSignalRef=FV_SelDrvMdeSte_D_Stat
        StePinAn_No_Cs: ComBitPosition=39, ComBitSize=8, ComSignalEndianness=BIG_ENDIAN, ComSignalInitValue=0, ComTransferProperty=PENDING, ComSignalAccess=ACCESS_NEEDED_BY_SWC_OR_COM, ComSignalType=UINT8, ComHandleId=39, ComSystemTemplateSystemSignalRef=StePinAn_No_Cs
        FV_LatCtlCpbltyDStat_No_Cs: ComBitPosition=47, ComBitSize=8, ComSignalEndianness=BIG_ENDIAN, ComSignalInitValue=0, ComTransferProperty=PENDING, ComSignalAccess=ACCESS_NEEDED_BY_SWC_OR_COM, ComSignalType=UINT8, ComHandleId=7, ComSystemTemplateSystemSignalRef=FV_LatCtlCpbltyDStat_No_Cs
        FV_VehVActlBrk_No_Cnt: ComBitPosition=21, ComBitSize=4, ComSignalEndianness=BIG_ENDIAN, ComSignalInitValue=0, ComSignalAccess=ACCESS_NEEDED_BY_SWC_OR_COM, ComSignalType=UINT8, ComHandleId=10, ComSystemTemplateSystemSignalRef=FV_VehVActlBrk_No_Cnt
        FV_EAC_AngleRequestEnable: ComBitPosition=23, ComBitSize=8, ComSignalEndianness=BIG_ENDIAN, ComSignalInitValue=0, ComSignalAccess=ACCESS_NEEDED_BY_SWC_OR_COM, ComSignalType=UINT8, ComHandleId=0, ComSystemTemplateSystemSignalRef=FV_EAC_AngleRequestEnable
        FV_LatCtlSte_D_Stat: ComBitPosition=18, ComBitSize=3, ComSignalEndianness=BIG_ENDIAN, ComSignalInitValue=0, ComTransferProperty=PENDING, ComSignalAccess=ACCESS_NEEDED_BY_SWC_OR_COM, ComSignalType=UINT8, ComHandleId=10, ComSystemTemplateSystemSignalRef=FV_LatCtlSte_D_Stat
        FV_TrlrHitchLamp_D_Rqst: ComBitPosition=24, ComBitSize=1, ComSignalEndianness=BIG_ENDIAN, ComSignalInitValue=0, ComTransferProperty=PENDING, ComSignalAccess=ACCESS_NEEDED_BY_SWC_OR_COM, ComSignalType=UINT8, ComHandleId=34, ComSystemTemplateSystemSignalRef=FV_TrlrHitchLamp_D_Rqst
        FV_SteeringColumnTorque: ComBitPosition=7, ComBitSize=8, ComSignalEndianness=BIG_ENDIAN, ComSignalInitValue=0, ComTransferProperty=PENDING, ComSignalAccess=ACCESS_NEEDED_BY_SWC_OR_COM, ComSignalType=UINT8, ComHandleId=23, ComSystemTemplateSystemSignalRef=FV_SteeringColumnTorque
        FV_VehVTrlrAid_B_Rq: ComBitPosition=25, ComBitSize=1, ComSignalEndianness=BIG_ENDIAN, ComSignalInitValue=0, ComTransferProperty=PENDING, ComSignalAccess=ACCESS_NEEDED_BY_SWC_OR_COM, ComSignalType=UINT8, ComHandleId=35, ComSystemTemplateSystemSignalRef=FV_VehVTrlrAid_B_Rq
        FV_SAPPAngleControlStat6: ComBitPosition=15, ComBitSize=1, ComSignalEndianness=BIG_ENDIAN, ComSignalInitValue=0, ComTransferProperty=PENDING, ComSignalAccess=ACCESS_NEEDED_BY_SWC_OR_COM, ComSignalType=UINT8, ComHandleId=18, ComSystemTemplateSystemSignalRef=FV_SAPPAngleControlStat6
        FV_TrlrAn_An_MxCalc: ComBitPosition=55, ComBitSize=7, ComSignalEndianness=BIG_ENDIAN, ComSignalInitValue=0, ComTransferProperty=PENDING, ComSignalAccess=ACCESS_NEEDED_BY_SWC_OR_COM, ComSignalType=UINT8, ComHandleId=31, ComSystemTemplateSystemSignalRef=FV_TrlrAn_An_MxCalc
        FV_TrlrAidSetup_D2_Stat: ComBitPosition=47, ComBitSize=3, ComSignalEndianness=BIG_ENDIAN, ComSignalInitValue=0, ComTransferProperty=PENDING, ComSignalAccess=ACCESS_NEEDED_BY_SWC_OR_COM, ComSignalType=UINT8, ComHandleId=27, ComSystemTemplateSystemSignalRef=FV_TrlrAidSetup_D2_Stat
        StePinComp_An_Est: ComBitPosition=22, ComBitSize=15, ComSignalEndianness=BIG_ENDIAN, ComSignalInitValue=0, ComTransferProperty=PENDING, ComSignalAccess=ACCESS_NEEDED_BY_SWC_OR_COM, ComSignalType=UINT16, ComHandleId=41, ComSystemTemplateSystemSignalRef=StePinComp_An_Est
        FV_TrlrAidTrlrId_No_Rq: ComBitPosition=63, ComBitSize=4, ComSignalEndianness=BIG_ENDIAN, ComSignalInitValue=0, ComTransferProperty=PENDING, ComSignalAccess=ACCESS_NEEDED_BY_SWC_OR_COM, ComSignalType=UINT8, ComHandleId=29, ComSystemTemplateSystemSignalRef=FV_TrlrAidTrlrId_No_Rq
        StePinRelInit_An_Sns: ComBitPosition=7, ComBitSize=16, ComSignalEndianness=BIG_ENDIAN, ComSignalInitValue=0, ComTransferProperty=PENDING, ComSignalAccess=ACCESS_NEEDED_BY_SWC_OR_COM, ComSignalType=UINT16, ComHandleId=42, ComSystemTemplateSystemSignalRef=StePinRelInit_An_Sns
        FV_LatCtlCpblty_D_Stat: ComBitPosition=39, ComBitSize=2, ComSignalEndianness=BIG_ENDIAN, ComSignalInitValue=0, ComTransferProperty=PENDING, ComSignalAccess=ACCESS_NEEDED_BY_SWC_OR_COM, ComSignalType=UINT8, ComHandleId=8, ComSystemTemplateSystemSignalRef=FV_LatCtlCpblty_D_Stat
        FV_VehLatLongVert_No_Cnt: ComBitPosition=63, ComBitSize=8, ComSignalEndianness=BIG_ENDIAN, ComSignalInitValue=0, ComSignalAccess=ACCESS_NEEDED_BY_SWC_OR_COM, ComSignalType=UINT8, ComHandleId=6, ComSystemTemplateSystemSignalRef=FV_VehLatLongVert_No_Cnt
        TS3: ComBitPosition=32, ComBitSize=8, ComSignalEndianness=LITTLE_ENDIAN, ComSignalInitValue=0, ComSignalType=SINT8, ComTimeout=0, ComTransferProperty=PENDING, ComSignalAccess=ACCESS_NEEDED_BY_SWC_OR_COM, ComHandleId=45, ComSystemTemplateSystemSignalRef=TS3
        StePinAn_No_Cnt: ComBitPosition=47, ComBitSize=4, ComSignalEndianness=BIG_ENDIAN, ComSignalInitValue=0, ComTransferProperty=PENDING, ComSignalAccess=ACCESS_NEEDED_BY_SWC_OR_COM, ComSignalType=UINT8, ComHandleId=38, ComSystemTemplateSystemSignalRef=StePinAn_No_Cnt
        FV_VehVActlBrk_No_Cs: ComBitPosition=31, ComBitSize=8, ComSignalEndianness=BIG_ENDIAN, ComSignalInitValue=0, ComSignalAccess=ACCESS_NEEDED_BY_SWC_OR_COM, ComSignalType=UINT8, ComHandleId=11, ComSystemTemplateSystemSignalRef=FV_VehVActlBrk_No_Cs
        FV_SAPPAngleControlStat5: ComBitPosition=14, ComBitSize=1, ComSignalEndianness=BIG_ENDIAN, ComSignalInitValue=0, ComTransferProperty=PENDING, ComSignalAccess=ACCESS_NEEDED_BY_SWC_OR_COM, ComSignalType=UINT8, ComHandleId=17, ComSystemTemplateSystemSignalRef=FV_SAPPAngleControlStat5
        FV_VehVActlBrk_D_Qf: ComBitPosition=23, ComBitSize=2, ComSignalEndianness=BIG_ENDIAN, ComSignalInitValue=0, ComSignalAccess=ACCESS_NEEDED_BY_SWC_OR_COM, ComSignalType=UINT8, ComHandleId=9, ComSystemTemplateSystemSignalRef=FV_VehVActlBrk_D_Qf
        FV_TrlrAidMsgTxt_D2_Rq: ComBitPosition=14, ComBitSize=6, ComSignalEndianness=BIG_ENDIAN, ComSignalInitValue=0, ComTransferProperty=PENDING, ComSignalAccess=ACCESS_NEEDED_BY_SWC_OR_COM, ComSignalType=UINT8, ComHandleId=26, ComSystemTemplateSystemSignalRef=FV_TrlrAidMsgTxt_D2_Rq
        FV_TrlrAidTrgtId_No_Rq: ComBitPosition=44, ComBitSize=5, ComSignalEndianness=BIG_ENDIAN, ComSignalInitValue=0, ComTransferProperty=PENDING, ComSignalAccess=ACCESS_NEEDED_BY_SWC_OR_COM, ComSignalType=UINT8, ComHandleId=28, ComSystemTemplateSystemSignalRef=FV_TrlrAidTrgtId_No_Rq
        FV_EAC_AngleRequest: ComBitPosition=7, ComBitSize=16, ComSignalEndianness=BIG_ENDIAN, ComSignalInitValue=0, ComSignalAccess=ACCESS_NEEDED_BY_SWC_OR_COM, ComSignalType=UINT16, ComHandleId=1, ComSystemTemplateSystemSignalRef=FV_EAC_AngleRequest
        FV_LaHandsOff_B_Actl: ComBitPosition=7, ComBitSize=1, ComSignalEndianness=BIG_ENDIAN, ComSignalInitValue=0, ComTransferProperty=PENDING, ComSignalAccess=ACCESS_NEEDED_BY_SWC_OR_COM, ComSignalType=UINT8, ComHandleId=5, ComSystemTemplateSystemSignalRef=FV_LaHandsOff_B_Actl
        FV_EsaOn_B_Stat: ComBitPosition=23, ComBitSize=1, ComSignalEndianness=BIG_ENDIAN, ComSignalInitValue=1, ComTransferProperty=PENDING, ComSignalAccess=ACCESS_NEEDED_BY_SWC_OR_COM, ComSignalType=UINT8, ComHandleId=1, ComSystemTemplateSystemSignalRef=FV_EsaOn_B_Stat
        TS2: ComBitPosition=16, ComBitSize=16, ComSignalEndianness=LITTLE_ENDIAN, ComSignalInitValue=0, ComSignalType=SINT16, ComTimeout=0, ComTransferProperty=PENDING, ComSignalAccess=ACCESS_NEEDED_BY_SWC_OR_COM, ComHandleId=44, ComSystemTemplateSystemSignalRef=TS2
        FV_SAPPAngleControlStat1: ComBitPosition=23, ComBitSize=2, ComSignalEndianness=BIG_ENDIAN, ComSignalInitValue=0, ComTransferProperty=PENDING, ComSignalAccess=ACCESS_NEEDED_BY_SWC_OR_COM, ComSignalType=UINT8, ComHandleId=13, ComSystemTemplateSystemSignalRef=FV_SAPPAngleControlStat1
        StePinCompAnEst_D_Qf: ComBitPosition=43, ComBitSize=2, ComSignalEndianness=BIG_ENDIAN, ComSignalInitValue=0, ComTransferProperty=PENDING, ComSignalAccess=ACCESS_NEEDED_BY_SWC_OR_COM, ComSignalType=UINT8, ComHandleId=40, ComSystemTemplateSystemSignalRef=StePinCompAnEst_D_Qf
        FV_LsmcBrk_Tq_Rq: ComBitPosition=15, ComBitSize=13, ComSignalEndianness=BIG_ENDIAN, ComSignalInitValue=0, ComTransferProperty=PENDING, ComSignalAccess=ACCESS_NEEDED_BY_SWC_OR_COM, ComSignalType=UINT16, ComHandleId=12, ComSystemTemplateSystemSignalRef=FV_LsmcBrk_Tq_Rq
        FV_SteMdule_D_Stat: ComBitPosition=55, ComBitSize=3, ComSignalEndianness=BIG_ENDIAN, ComSignalInitValue=0, ComTransferProperty=PENDING, ComSignalAccess=ACCESS_NEEDED_BY_SWC_OR_COM, ComSignalType=UINT8, ComHandleId=20, ComSystemTemplateSystemSignalRef=FV_SteMdule_D_Stat
        FV_LatCtlLim_D_Stat: ComBitPosition=33, ComBitSize=2, ComSignalEndianness=BIG_ENDIAN, ComSignalInitValue=0, ComTransferProperty=PENDING, ComSignalAccess=ACCESS_NEEDED_BY_SWC_OR_COM, ComSignalType=UINT8, ComHandleId=9, ComSystemTemplateSystemSignalRef=FV_LatCtlLim_D_Stat
        TS1: ComBitPosition=0, ComBitSize=16, ComSignalEndianness=LITTLE_ENDIAN, ComSignalInitValue=1, ComSignalType=SINT16, ComTimeout=0, ComTransferProperty=PENDING, ComSignalAccess=ACCESS_NEEDED_BY_SWC_OR_COM, ComHandleId=43, ComSystemTemplateSystemSignalRef=TS1
        FV_LaActAvail_D2_Actl: ComBitPosition=5, ComBitSize=2, ComSignalEndianness=BIG_ENDIAN, ComSignalInitValue=0, ComTransferProperty=PENDING, ComSignalAccess=ACCESS_NEEDED_BY_SWC_OR_COM, ComSignalType=UINT8, ComHandleId=3, ComSystemTemplateSystemSignalRef=FV_LaActAvail_D2_Actl
        FV_VehVert2_A_Actl: ComBitPosition=36, ComBitSize=13, ComSignalEndianness=BIG_ENDIAN, ComSignalInitValue=0, ComSignalAccess=ACCESS_NEEDED_BY_SWC_OR_COM, ComSignalType=UINT16, ComHandleId=12, ComSystemTemplateSystemSignalRef=FV_VehVert2_A_Actl
        FV_VehLong2_A_Actl: ComBitPosition=20, ComBitSize=13, ComSignalEndianness=BIG_ENDIAN, ComSignalInitValue=0, ComSignalAccess=ACCESS_NEEDED_BY_SWC_OR_COM, ComSignalType=UINT16, ComHandleId=7, ComSystemTemplateSystemSignalRef=FV_VehLong2_A_Actl
        FV_TjaHandsOnCnfdnc_B_Est: ComBitPosition=3, ComBitSize=1, ComSignalEndianness=BIG_ENDIAN, ComSignalInitValue=0, ComTransferProperty=PENDING, ComSignalAccess=ACCESS_NEEDED_BY_SWC_OR_COM, ComSignalType=UINT8, ComHandleId=24, ComSystemTemplateSystemSignalRef=FV_TjaHandsOnCnfdnc_B_Est
        FV_TrlrAn_An_WarnCalc: ComBitPosition=28, ComBitSize=5, ComSignalEndianness=BIG_ENDIAN, ComSignalInitValue=0, ComTransferProperty=PENDING, ComSignalAccess=ACCESS_NEEDED_BY_SWC_OR_COM, ComSignalType=UINT8, ComHandleId=33, ComSystemTemplateSystemSignalRef=FV_TrlrAn_An_WarnCalc
        FV_VehLatAActl_D_Qf: ComBitPosition=6, ComBitSize=2, ComSignalEndianness=BIG_ENDIAN, ComSignalInitValue=0, ComSignalAccess=ACCESS_NEEDED_BY_SWC_OR_COM, ComSignalType=UINT8, ComHandleId=4, ComSystemTemplateSystemSignalRef=FV_VehLatAActl_D_Qf
        FV_VehLongAActl_D_Qf: ComBitPosition=22, ComBitSize=2, ComSignalEndianness=BIG_ENDIAN, ComSignalInitValue=0, ComSignalAccess=ACCESS_NEEDED_BY_SWC_OR_COM, ComSignalType=UINT8, ComHandleId=8, ComSystemTemplateSystemSignalRef=FV_VehLongAActl_D_Qf
        FV_EPAS_Failure: ComBitPosition=9, ComBitSize=2, ComSignalEndianness=BIG_ENDIAN, ComSignalInitValue=0, ComTransferProperty=PENDING, ComSignalAccess=ACCESS_NEEDED_BY_SWC_OR_COM, ComSignalType=UINT8, ComHandleId=0, ComSystemTemplateSystemSignalRef=FV_EPAS_Failure
        FV_SAPPAngleControlStat3: ComBitPosition=12, ComBitSize=1, ComSignalEndianness=BIG_ENDIAN, ComSignalInitValue=0, ComTransferProperty=PENDING, ComSignalAccess=ACCESS_NEEDED_BY_SWC_OR_COM, ComSignalType=UINT8, ComHandleId=15, ComSystemTemplateSystemSignalRef=FV_SAPPAngleControlStat3
        FV_VehLatLongVertA_No_Cs: ComBitPosition=55, ComBitSize=8, ComSignalEndianness=BIG_ENDIAN, ComSignalInitValue=0, ComSignalAccess=ACCESS_NEEDED_BY_SWC_OR_COM, ComSignalType=UINT8, ComHandleId=5, ComSystemTemplateSystemSignalRef=FV_VehLatLongVertA_No_Cs
        FV_HitchToTrlrAxle_L_Calc: ComBitPosition=7, ComBitSize=9, ComSignalEndianness=BIG_ENDIAN, ComSignalInitValue=0, ComTransferProperty=PENDING, ComSignalAccess=ACCESS_NEEDED_BY_SWC_OR_COM, ComSignalType=UINT16, ComHandleId=2, ComSystemTemplateSystemSignalRef=FV_HitchToTrlrAxle_L_Calc
        FV_Veh_V_RqMxTrlrAid: ComBitPosition=63, ComBitSize=8, ComSignalEndianness=BIG_ENDIAN, ComSignalInitValue=0, ComTransferProperty=PENDING, ComSignalAccess=ACCESS_NEEDED_BY_SWC_OR_COM, ComSignalType=UINT8, ComHandleId=36, ComSystemTemplateSystemSignalRef=FV_Veh_V_RqMxTrlrAid
        FV_WhlRr_W_Meas: ComBitPosition=54, ComBitSize=15, ComSignalEndianness=BIG_ENDIAN, ComSignalInitValue=0, ComSignalAccess=ACCESS_NEEDED_BY_SWC_OR_COM, ComSignalType=UINT16, ComHandleId=18, ComSystemTemplateSystemSignalRef=FV_WhlRr_W_Meas
        FV_SAPPAngleControlStat2: ComBitPosition=11, ComBitSize=1, ComSignalEndianness=BIG_ENDIAN, ComSignalInitValue=0, ComTransferProperty=PENDING, ComSignalAccess=ACCESS_NEEDED_BY_SWC_OR_COM, ComSignalType=UINT8, ComHandleId=14, ComSystemTemplateSystemSignalRef=FV_SAPPAngleControlStat2
        FV_LaActDeny_B_Actl: ComBitPosition=6, ComBitSize=1, ComSignalEndianness=BIG_ENDIAN, ComSignalInitValue=0, ComTransferProperty=PENDING, ComSignalAccess=ACCESS_NEEDED_BY_SWC_OR_COM, ComSignalType=UINT8, ComHandleId=4, ComSystemTemplateSystemSignalRef=FV_LaActDeny_B_Actl
        FV_WhlRl_W_Meas: ComBitPosition=38, ComBitSize=15, ComSignalEndianness=BIG_ENDIAN, ComSignalInitValue=0, ComSignalAccess=ACCESS_NEEDED_BY_SWC_OR_COM, ComSignalType=UINT16, ComHandleId=17, ComSystemTemplateSystemSignalRef=FV_WhlRl_W_Meas
        FV_WhlFr_W_Meas: ComBitPosition=22, ComBitSize=15, ComSignalEndianness=BIG_ENDIAN, ComSignalInitValue=0, ComSignalAccess=ACCESS_NEEDED_BY_SWC_OR_COM, ComSignalType=UINT16, ComHandleId=16, ComSystemTemplateSystemSignalRef=FV_WhlFr_W_Meas
        FV_LatCtlCpbltyDStat_No_Cnt: ComBitPosition=37, ComBitSize=4, ComSignalEndianness=BIG_ENDIAN, ComSignalInitValue=0, ComTransferProperty=PENDING, ComSignalAccess=ACCESS_NEEDED_BY_SWC_OR_COM, ComSignalType=UINT8, ComHandleId=6, ComSystemTemplateSystemSignalRef=FV_LatCtlCpbltyDStat_No_Cnt
        FV_TrlrAn_An_TrgtCalc: ComBitPosition=31, ComBitSize=8, ComSignalEndianness=BIG_ENDIAN, ComSignalInitValue=0, ComTransferProperty=PENDING, ComSignalAccess=ACCESS_NEEDED_BY_SWC_OR_COM, ComSignalType=UINT8, ComHandleId=32, ComSystemTemplateSystemSignalRef=FV_TrlrAn_An_TrgtCalc
        FV_VehLat2_A_Actl: ComBitPosition=4, ComBitSize=13, ComSignalEndianness=BIG_ENDIAN, ComSignalInitValue=0, ComSignalAccess=ACCESS_NEEDED_BY_SWC_OR_COM, ComSignalType=UINT16, ComHandleId=3, ComSystemTemplateSystemSignalRef=FV_VehLat2_A_Actl
        FV_EAC_CANValid: ComBitPosition=31, ComBitSize=8, ComSignalEndianness=BIG_ENDIAN, ComSignalInitValue=0, ComSignalAccess=ACCESS_NEEDED_BY_SWC_OR_COM, ComSignalType=UINT8, ComHandleId=2, ComSystemTemplateSystemSignalRef=FV_EAC_CANValid
        FV_LsmcBrkDecelEnbl_D_Rq: ComBitPosition=1, ComBitSize=2, ComSignalEndianness=BIG_ENDIAN, ComSignalInitValue=0, ComTransferProperty=PENDING, ComSignalAccess=ACCESS_NEEDED_BY_SWC_OR_COM, ComSignalType=UINT8, ComHandleId=11, ComSystemTemplateSystemSignalRef=FV_LsmcBrkDecelEnbl_D_Rq
        FV_SAPPAngleControlStat4: ComBitPosition=13, ComBitSize=1, ComSignalEndianness=BIG_ENDIAN, ComSignalInitValue=0, ComTransferProperty=PENDING, ComSignalAccess=ACCESS_NEEDED_BY_SWC_OR_COM, ComSignalType=UINT8, ComHandleId=16, ComSystemTemplateSystemSignalRef=FV_SAPPAngleControlStat4
        FV_SteMdule_I_Est: ComBitPosition=21, ComBitSize=12, ComSignalEndianness=BIG_ENDIAN, ComSignalInitValue=0, ComTransferProperty=PENDING, ComSignalAccess=ACCESS_NEEDED_BY_SWC_OR_COM, ComSignalType=UINT16, ComHandleId=21, ComSystemTemplateSystemSignalRef=FV_SteMdule_I_Est
        SteEffort_D_Stat: ComBitPosition=52, ComBitSize=3, ComSignalEndianness=BIG_ENDIAN, ComSignalInitValue=0, ComTransferProperty=PENDING, ComSignalAccess=ACCESS_NEEDED_BY_SWC_OR_COM, ComSignalType=UINT8, ComHandleId=37, ComSystemTemplateSystemSignalRef=SteEffort_D_Stat
        FV_WhlFl_W_Meas: ComBitPosition=6, ComBitSize=15, ComSignalEndianness=BIG_ENDIAN, ComSignalInitValue=0, ComSignalAccess=ACCESS_NEEDED_BY_SWC_OR_COM, ComSignalType=UINT16, ComHandleId=15, ComSystemTemplateSystemSignalRef=FV_WhlFl_W_Meas
        FV_Veh_V_ActlBrk_oBrkSysFtr_oCAN00_ec1237cc_Rx: ComBitPosition=7, ComBitSize=16, ComSignalEndianness=BIG_ENDIAN, ComSignalInitValue=0, ComSignalAccess=ACCESS_UNCLEAR, ComSignalType=UINT8, ComHandleId=0, ComSystemTemplateSystemSignalRef=FV_Veh_V_ActlBrk
        FV_SteMdule_U_Meas_oEPAS_INFO_oCAN00_d76bf1e6_Tx: ComBitPosition=39, ComBitSize=8, ComSignalEndianness=BIG_ENDIAN, ComSignalInitValue=0, ComTransferProperty=PENDING, ComSignalAccess=ACCESS_UNCLEAR, ComSignalType=UINT8, ComHandleId=0, ComSystemTemplateSystemSignalRef=FV_SteMdule_U_Meas
        TS4_oTM_oCAN00_40e19a75_Tx: ComBitPosition=40, ComBitSize=8, ComSignalEndianness=LITTLE_ENDIAN, ComSignalInitValue=0, ComTransferProperty=PENDING, ComSignalAccess=ACCESS_UNCLEAR, ComSignalType=UINT8, ComHandleId=0, ComSystemTemplateSystemSignalRef=TS4
        FV_TrlrAnOffst_An2_Calc_oTrlrAid_D2_oCAN00_a28765f2_Tx: ComBitPosition=39, ComBitSize=8, ComSignalEndianness=BIG_ENDIAN, ComSignalInitValue=0, ComTransferProperty=PENDING, ComSignalAccess=ACCESS_UNCLEAR, ComSignalType=UINT8, ComHandleId=0, ComSystemTemplateSystemSignalRef=FV_TrlrAnOffst_An2_Calc
        FV_TrlrAidEnbl_D2_Stat_oTrlrAid_D2_oCAN00_a9fbcff0_Tx: ComBitPosition=31, ComBitSize=3, ComSignalEndianness=BIG_ENDIAN, ComSignalInitValue=0, ComTransferProperty=PENDING, ComSignalAccess=ACCESS_UNCLEAR, ComSignalType=UINT8, ComHandleId=0, ComSystemTemplateSystemSignalRef=FV_TrlrAidEnbl_D2_Stat
        FV_VehVertAActl_D_Qf_oAccel_Data_oCAN00_d9efca2d_Rx: ComBitPosition=38, ComBitSize=2, ComSignalEndianness=BIG_ENDIAN, ComSignalInitValue=0, ComSignalAccess=ACCESS_UNCLEAR, ComSignalType=UINT8, ComHandleId=0, ComSystemTemplateSystemSignalRef=FV_VehVertAActl_D_Qf
        FV_SelDrvMdeSte_D_Stat_oTrlrAid_D2_oCAN00_732052ec_Tx: ComBitPosition=17, ComBitSize=2, ComSignalEndianness=BIG_ENDIAN, ComSignalInitValue=0, ComTransferProperty=PENDING, ComSignalAccess=ACCESS_UNCLEAR, ComSignalType=UINT8, ComHandleId=0, ComSystemTemplateSystemSignalRef=FV_SelDrvMdeSte_D_Stat
        StePinAn_No_Cs_oStrgPn_D_oCAN00_4581731e_Tx: ComBitPosition=39, ComBitSize=8, ComSignalEndianness=BIG_ENDIAN, ComSignalInitValue=0, ComTransferProperty=PENDING, ComSignalAccess=ACCESS_UNCLEAR, ComSignalType=UINT8, ComHandleId=0, ComSystemTemplateSystemSignalRef=StePinAn_No_Cs
        FV_LatCtlCpbltyDStat_No_Cs_oLAst_D3_oCAN00_711cc2cd_Tx: ComBitPosition=47, ComBitSize=8, ComSignalEndianness=BIG_ENDIAN, ComSignalInitValue=0, ComTransferProperty=PENDING, ComSignalAccess=ACCESS_UNCLEAR, ComSignalType=UINT8, ComHandleId=0, ComSystemTemplateSystemSignalRef=FV_LatCtlCpbltyDStat_No_Cs
        FV_VehVActlBrk_No_Cnt_oBrkSysFtr_oCAN00_d8f8c8c9_Rx: ComBitPosition=21, ComBitSize=4, ComSignalEndianness=BIG_ENDIAN, ComSignalInitValue=0, ComSignalAccess=ACCESS_UNCLEAR, ComSignalType=UINT8, ComHandleId=0, ComSystemTemplateSystemSignalRef=FV_VehVActlBrk_No_Cnt
        FV_EAC_AngleRequestEnable_oEAC_Request_oCAN00_fccf3f58_Rx: ComBitPosition=23, ComBitSize=8, ComSignalEndianness=BIG_ENDIAN, ComSignalInitValue=0, ComSignalAccess=ACCESS_UNCLEAR, ComSignalType=UINT8, ComHandleId=0, ComSystemTemplateSystemSignalRef=FV_EAC_AngleRequestEnable
        FV_LatCtlSte_D_Stat_oLAst_D3_oCAN00_fafe6da3_Tx: ComBitPosition=18, ComBitSize=3, ComSignalEndianness=BIG_ENDIAN, ComSignalInitValue=0, ComTransferProperty=PENDING, ComSignalAccess=ACCESS_UNCLEAR, ComSignalType=UINT8, ComHandleId=0, ComSystemTemplateSystemSignalRef=FV_LatCtlSte_D_Stat
        XCP_TX_oXCP_TX_oCAN00_64e07a05_Tx: ComBitPosition=0, ComSignalEndianness=opaque, ComSignalInitValue=0 0 0 0 0 0 0 0, ComSignalLength=8, ComTransferProperty=PENDING, ComSignalAccess=ACCESS_UNCLEAR, ComSignalType=UINT8, ComHandleId=0, ComSystemTemplateSystemSignalRef=XCP_TX
        FV_TrlrHitchLamp_D_Rqst_oEPAS_INFO_oCAN00_5ad48b42_Tx: ComBitPosition=24, ComBitSize=1, ComSignalEndianness=BIG_ENDIAN, ComSignalInitValue=0, ComTransferProperty=PENDING, ComSignalAccess=ACCESS_UNCLEAR, ComSignalType=UINT8, ComHandleId=0, ComSystemTemplateSystemSignalRef=FV_TrlrHitchLamp_D_Rqst
        FV_SteeringColumnTorque_oEPAS_INFO_oCAN00_c7fbe189_Tx: ComBitPosition=7, ComBitSize=8, ComSignalEndianness=BIG_ENDIAN, ComSignalInitValue=0, ComTransferProperty=PENDING, ComSignalAccess=ACCESS_UNCLEAR, ComSignalType=UINT8, ComHandleId=0, ComSystemTemplateSystemSignalRef=FV_SteeringColumnTorque
        FV_VehVTrlrAid_B_Rq_oEPAS_INFO_oCAN00_6b55d9a4_Tx: ComBitPosition=25, ComBitSize=1, ComSignalEndianness=BIG_ENDIAN, ComSignalInitValue=0, ComTransferProperty=PENDING, ComSignalAccess=ACCESS_UNCLEAR, ComSignalType=UINT8, ComHandleId=0, ComSystemTemplateSystemSignalRef=FV_VehVTrlrAid_B_Rq
        FV_SAPPAngleControlStat6_oEPAS_INFO_oCAN00_49c9ddd8_Tx: ComBitPosition=15, ComBitSize=1, ComSignalEndianness=BIG_ENDIAN, ComSignalInitValue=0, ComTransferProperty=PENDING, ComSignalAccess=ACCESS_UNCLEAR, ComSignalType=UINT8, ComHandleId=0, ComSystemTemplateSystemSignalRef=FV_SAPPAngleControlStat6
        FV_TrlrAn_An_MxCalc_oTrlrAid_D2_oCAN00_27a34d68_Tx: ComBitPosition=55, ComBitSize=7, ComSignalEndianness=BIG_ENDIAN, ComSignalInitValue=0, ComTransferProperty=PENDING, ComSignalAccess=ACCESS_UNCLEAR, ComSignalType=UINT8, ComHandleId=0, ComSystemTemplateSystemSignalRef=FV_TrlrAn_An_MxCalc
        FV_TrlrAidSetup_D2_Stat_oTrlrAid_D2_oCAN00_faf4f004_Tx: ComBitPosition=47, ComBitSize=3, ComSignalEndianness=BIG_ENDIAN, ComSignalInitValue=0, ComTransferProperty=PENDING, ComSignalAccess=ACCESS_UNCLEAR, ComSignalType=UINT8, ComHandleId=0, ComSystemTemplateSystemSignalRef=FV_TrlrAidSetup_D2_Stat
        StePinComp_An_Est_oStrgPn_D_oCAN00_b8d3bdc9_Tx: ComBitPosition=22, ComBitSize=15, ComSignalEndianness=BIG_ENDIAN, ComSignalInitValue=0, ComTransferProperty=PENDING, ComSignalAccess=ACCESS_UNCLEAR, ComSignalType=UINT8, ComHandleId=0, ComSystemTemplateSystemSignalRef=StePinComp_An_Est
        FV_TrlrAidTrlrId_No_Rq_oTrlrAid_D2_oCAN00_b16cf22b_Tx: ComBitPosition=63, ComBitSize=4, ComSignalEndianness=BIG_ENDIAN, ComSignalInitValue=0, ComTransferProperty=PENDING, ComSignalAccess=ACCESS_UNCLEAR, ComSignalType=UINT8, ComHandleId=0, ComSystemTemplateSystemSignalRef=FV_TrlrAidTrlrId_No_Rq
        StePinRelInit_An_Sns_oStrgPn_D_oCAN00_c643371e_Tx: ComBitPosition=7, ComBitSize=16, ComSignalEndianness=BIG_ENDIAN, ComSignalInitValue=0, ComTransferProperty=PENDING, ComSignalAccess=ACCESS_UNCLEAR, ComSignalType=UINT8, ComHandleId=0, ComSystemTemplateSystemSignalRef=StePinRelInit_An_Sns
        FV_LatCtlCpblty_D_Stat_oLAst_D3_oCAN00_259a7af1_Tx: ComBitPosition=39, ComBitSize=2, ComSignalEndianness=BIG_ENDIAN, ComSignalInitValue=0, ComTransferProperty=PENDING, ComSignalAccess=ACCESS_UNCLEAR, ComSignalType=UINT8, ComHandleId=0, ComSystemTemplateSystemSignalRef=FV_LatCtlCpblty_D_Stat
        FV_VehLatLongVert_No_Cnt_oAccel_Data_oCAN00_42c3752c_Rx: ComBitPosition=63, ComBitSize=8, ComSignalEndianness=BIG_ENDIAN, ComSignalInitValue=0, ComSignalAccess=ACCESS_UNCLEAR, ComSignalType=UINT8, ComHandleId=0, ComSystemTemplateSystemSignalRef=FV_VehLatLongVert_No_Cnt
        WOA_TargetTorque_oWOA_oCAN00_9d8d5f66_Tx: ComBitPosition=0, ComBitSize=8, ComSignalEndianness=LITTLE_ENDIAN, ComSignalInitValue=0, ComSignalType=SINT8, ComTimeout=0, ComTransferProperty=PENDING, ComSignalAccess=ACCESS_UNCLEAR, ComHandleId=0, ComSystemTemplateSystemSignalRef=WOA_TargetTorque
        TS3_oTM_oCAN00_347973fa_Tx: ComBitPosition=32, ComBitSize=8, ComSignalEndianness=LITTLE_ENDIAN, ComSignalInitValue=0, ComTransferProperty=PENDING, ComSignalAccess=ACCESS_UNCLEAR, ComSignalType=UINT8, ComHandleId=0, ComSystemTemplateSystemSignalRef=TS3
        StePinAn_No_Cnt_oStrgPn_D_oCAN00_91969038_Tx: ComBitPosition=47, ComBitSize=4, ComSignalEndianness=BIG_ENDIAN, ComSignalInitValue=0, ComTransferProperty=PENDING, ComSignalAccess=ACCESS_UNCLEAR, ComSignalType=UINT8, ComHandleId=0, ComSystemTemplateSystemSignalRef=StePinAn_No_Cnt
        FV_VehVActlBrk_No_Cs_oBrkSysFtr_oCAN00_e6dc4841_Rx: ComBitPosition=31, ComBitSize=8, ComSignalEndianness=BIG_ENDIAN, ComSignalInitValue=0, ComSignalAccess=ACCESS_UNCLEAR, ComSignalType=UINT8, ComHandleId=0, ComSystemTemplateSystemSignalRef=FV_VehVActlBrk_No_Cs
        FV_SAPPAngleControlStat5_oEPAS_INFO_oCAN00_ea9f5b71_Tx: ComBitPosition=14, ComBitSize=1, ComSignalEndianness=BIG_ENDIAN, ComSignalInitValue=0, ComTransferProperty=PENDING, ComSignalAccess=ACCESS_UNCLEAR, ComSignalType=UINT8, ComHandleId=0, ComSystemTemplateSystemSignalRef=FV_SAPPAngleControlStat5
        FV_VehVActlBrk_D_Qf_oBrkSysFtr_oCAN00_23a5d28a_Rx: ComBitPosition=23, ComBitSize=2, ComSignalEndianness=BIG_ENDIAN, ComSignalInitValue=0, ComSignalAccess=ACCESS_UNCLEAR, ComSignalType=UINT8, ComHandleId=0, ComSystemTemplateSystemSignalRef=FV_VehVActlBrk_D_Qf
        FV_TrlrAidMsgTxt_D2_Rq_oTrlrAid_D2_oCAN00_9026eb20_Tx: ComBitPosition=14, ComBitSize=6, ComSignalEndianness=BIG_ENDIAN, ComSignalInitValue=0, ComTransferProperty=PENDING, ComSignalAccess=ACCESS_UNCLEAR, ComSignalType=UINT8, ComHandleId=0, ComSystemTemplateSystemSignalRef=FV_TrlrAidMsgTxt_D2_Rq
        FV_TrlrAidTrgtId_No_Rq_oTrlrAid_D2_oCAN00_bf0452ab_Tx: ComBitPosition=44, ComBitSize=5, ComSignalEndianness=BIG_ENDIAN, ComSignalInitValue=0, ComTransferProperty=PENDING, ComSignalAccess=ACCESS_UNCLEAR, ComSignalType=UINT8, ComHandleId=0, ComSystemTemplateSystemSignalRef=FV_TrlrAidTrgtId_No_Rq
        FV_EAC_AngleRequest_oEAC_Request_oCAN00_77e91227_Rx: ComBitPosition=7, ComBitSize=16, ComSignalEndianness=BIG_ENDIAN, ComSignalInitValue=0, ComSignalAccess=ACCESS_UNCLEAR, ComSignalType=UINT8, ComHandleId=0, ComSystemTemplateSystemSignalRef=FV_EAC_AngleRequest
        FV_LaHandsOff_B_Actl_oLAst_D3_oCAN00_684e7061_Tx: ComBitPosition=7, ComBitSize=1, ComSignalEndianness=BIG_ENDIAN, ComSignalInitValue=0, ComTransferProperty=PENDING, ComSignalAccess=ACCESS_UNCLEAR, ComSignalType=UINT8, ComHandleId=0, ComSystemTemplateSystemSignalRef=FV_LaHandsOff_B_Actl
        FV_EsaOn_B_Stat_oTrlrAid_D2_oCAN00_2d70d956_Tx: ComBitPosition=23, ComBitSize=1, ComSignalEndianness=BIG_ENDIAN, ComSignalInitValue=1, ComTransferProperty=PENDING, ComSignalAccess=ACCESS_UNCLEAR, ComSignalType=UINT8, ComHandleId=0, ComSystemTemplateSystemSignalRef=FV_EsaOn_B_Stat
        TS2_oTM_oCAN00_afdc3f95_Tx: ComBitPosition=16, ComBitSize=16, ComSignalEndianness=LITTLE_ENDIAN, ComSignalInitValue=0, ComTransferProperty=PENDING, ComSignalAccess=ACCESS_UNCLEAR, ComSignalType=UINT8, ComHandleId=0, ComSystemTemplateSystemSignalRef=TS2
        FV_SAPPAngleControlStat1_oEPAS_INFO_oCAN00_03f75693_Tx: ComBitPosition=23, ComBitSize=2, ComSignalEndianness=BIG_ENDIAN, ComSignalInitValue=0, ComTransferProperty=PENDING, ComSignalAccess=ACCESS_UNCLEAR, ComSignalType=UINT8, ComHandleId=0, ComSystemTemplateSystemSignalRef=FV_SAPPAngleControlStat1
        StePinCompAnEst_D_Qf_oStrgPn_D_oCAN00_8c4413a4_Tx: ComBitPosition=43, ComBitSize=2, ComSignalEndianness=BIG_ENDIAN, ComSignalInitValue=0, ComTransferProperty=PENDING, ComSignalAccess=ACCESS_UNCLEAR, ComSignalType=UINT8, ComHandleId=0, ComSystemTemplateSystemSignalRef=StePinCompAnEst_D_Qf
        FV_LsmcBrk_Tq_Rq_oLAst_D3_oCAN00_43eaaa75_Tx: ComBitPosition=15, ComBitSize=13, ComSignalEndianness=BIG_ENDIAN, ComSignalInitValue=0, ComTransferProperty=PENDING, ComSignalAccess=ACCESS_UNCLEAR, ComSignalType=UINT8, ComHandleId=0, ComSystemTemplateSystemSignalRef=FV_LsmcBrk_Tq_Rq
      WOA_oCAN00_cc969458_Tx (ComIPdu):
        ComIPduDirection = SEND
        ComIPduType = NORMAL
        ComIPduHandleId = 5
        ComIPduSignalProcessing = DEFERRED
        ComIPduCancellationSupport = false
        ComIPduGroupRef = EPS_oCAN00_Tx_6df63845
        ComIPduSignalRef = WOA_TargetTorque_oWOA_oCAN00_9d8d5f66_Tx
        ComPduIdRef = WOA_oCAN00_cc969458_Tx
        ComTxIPdu: ComMinimumDelayTime=0, ComTxIPduUnusedAreasDefault=0
          ComTxModeTrue
            ComTxMode: ComTxModeMode=NONE
          ComTxModeFalse
            ComTxMode: ComTxModeMode=NONE
      30 x ComSignal, all with ComSignalAccess=ACCESS_UNCLEAR, ComSignalType=UINT8, ComHandleId=0:
        FV_SteMdule_D_Stat_oEPAS_INFO_oCAN00_d560c704_Tx: ComBitPosition=55, ComBitSize=3, ComSignalEndianness=BIG_ENDIAN, ComSignalInitValue=0, ComTransferProperty=PENDING, ComSystemTemplateSystemSignalRef=FV_SteMdule_D_Stat
        FV_LatCtlLim_D_Stat_oLAst_D3_oCAN00_256132d3_Tx: ComBitPosition=33, ComBitSize=2, ComSignalEndianness=BIG_ENDIAN, ComSignalInitValue=0, ComTransferProperty=PENDING, ComSystemTemplateSystemSignalRef=FV_LatCtlLim_D_Stat
        TS1_oTM_oCAN00_d842ed65_Tx: ComBitPosition=0, ComBitSize=16, ComSignalEndianness=LITTLE_ENDIAN, ComSignalInitValue=1, ComTransferProperty=PENDING, ComSystemTemplateSystemSignalRef=TS1
        FV_LaActAvail_D2_Actl_oLAst_D3_oCAN00_f97f1300_Tx: ComBitPosition=5, ComBitSize=2, ComSignalEndianness=BIG_ENDIAN, ComSignalInitValue=0, ComTransferProperty=PENDING, ComSystemTemplateSystemSignalRef=FV_LaActAvail_D2_Actl
        FV_VehVert2_A_Actl_oAccel_Data_oCAN00_26fb041b_Rx: ComBitPosition=36, ComBitSize=13, ComSignalEndianness=BIG_ENDIAN, ComSignalInitValue=0, ComSystemTemplateSystemSignalRef=FV_VehVert2_A_Actl
        XCP_Rx_oXCP_RX_oCAN00_a7f1cffa_Rx: ComBitPosition=0, ComSignalEndianness=opaque, ComSignalInitValue=0 0 0 0 0 0 0 0, ComSignalLength=8, ComSystemTemplateSystemSignalRef=XCP_Rx
        FV_VehLong2_A_Actl_oAccel_Data_oCAN00_84393ab1_Rx: ComBitPosition=20, ComBitSize=13, ComSignalEndianness=BIG_ENDIAN, ComSignalInitValue=0, ComSystemTemplateSystemSignalRef=FV_VehLong2_A_Actl
        FV_TjaHandsOnCnfdnc_B_Est_oLAst_D3_oCAN00_43e38363_Tx: ComBitPosition=3, ComBitSize=1, ComSignalEndianness=BIG_ENDIAN, ComSignalInitValue=0, ComTransferProperty=PENDING, ComSystemTemplateSystemSignalRef=FV_TjaHandsOnCnfdnc_B_Est
        FV_TrlrAn_An_WarnCalc_oTrlrAid_D2_oCAN00_ce1f32c3_Tx: ComBitPosition=28, ComBitSize=5, ComSignalEndianness=BIG_ENDIAN, ComSignalInitValue=0, ComTransferProperty=PENDING, ComSystemTemplateSystemSignalRef=FV_TrlrAn_An_WarnCalc
        FV_VehLatAActl_D_Qf_oAccel_Data_oCAN00_6babd333_Rx: ComBitPosition=6, ComBitSize=2, ComSignalEndianness=BIG_ENDIAN, ComSignalInitValue=0, ComSystemTemplateSystemSignalRef=FV_VehLatAActl_D_Qf
        FV_VehLongAActl_D_Qf_oAccel_Data_oCAN00_4c662127_Rx: ComBitPosition=22, ComBitSize=2, ComSignalEndianness=BIG_ENDIAN, ComSignalInitValue=0, ComSystemTemplateSystemSignalRef=FV_VehLongAActl_D_Qf
        FV_EPAS_Failure_oEPAS_INFO_oCAN00_97b9f280_Tx: ComBitPosition=9, ComBitSize=2, ComSignalEndianness=BIG_ENDIAN, ComSignalInitValue=0, ComTransferProperty=PENDING, ComSystemTemplateSystemSignalRef=FV_EPAS_Failure
        FV_SAPPAngleControlStat3_oEPAS_INFO_oCAN00_77435062_Tx: ComBitPosition=12, ComBitSize=1, ComSignalEndianness=BIG_ENDIAN, ComSignalInitValue=0, ComTransferProperty=PENDING, ComSystemTemplateSystemSignalRef=FV_SAPPAngleControlStat3
        FV_VehLatLongVertA_No_Cs_oAccel_Data_oCAN00_91d68ae9_Rx: ComBitPosition=55, ComBitSize=8, ComSignalEndianness=BIG_ENDIAN, ComSignalInitValue=0, ComSystemTemplateSystemSignalRef=FV_VehLatLongVertA_No_Cs
        FV_HitchToTrlrAxle_L_Calc_oTrlrAid_D2_oCAN00_1bfa249a_Tx: ComBitPosition=7, ComBitSize=9, ComSignalEndianness=BIG_ENDIAN, ComSignalInitValue=0, ComTransferProperty=PENDING, ComSystemTemplateSystemSignalRef=FV_HitchToTrlrAxle_L_Calc
        FV_Veh_V_RqMxTrlrAid_oEPAS_INFO_oCAN00_68afc19f_Tx: ComBitPosition=63, ComBitSize=8, ComSignalEndianness=BIG_ENDIAN, ComSignalInitValue=0, ComTransferProperty=PENDING, ComSystemTemplateSystemSignalRef=FV_Veh_V_RqMxTrlrAid
        FV_WhlRr_W_Meas_oWheelSpeed_FD3_oCAN00_ddb1d7ee_Rx: ComBitPosition=54, ComBitSize=15, ComSignalEndianness=BIG_ENDIAN, ComSignalInitValue=0, ComSystemTemplateSystemSignalRef=FV_WhlRr_W_Meas
        FV_SAPPAngleControlStat2_oEPAS_INFO_oCAN00_a0a1d03a_Tx: ComBitPosition=11, ComBitSize=1, ComSignalEndianness=BIG_ENDIAN, ComSignalInitValue=0, ComTransferProperty=PENDING, ComSystemTemplateSystemSignalRef=FV_SAPPAngleControlStat2
        FV_LaActDeny_B_Actl_oLAst_D3_oCAN00_0e7c7fb2_Tx: ComBitPosition=6, ComBitSize=1, ComSignalEndianness=BIG_ENDIAN, ComSignalInitValue=0, ComTransferProperty=PENDING, ComSystemTemplateSystemSignalRef=FV_LaActDeny_B_Actl
        FV_WhlRl_W_Meas_oWheelSpeed_FD3_oCAN00_62a06e90_Rx: ComBitPosition=38, ComBitSize=15, ComSignalEndianness=BIG_ENDIAN, ComSignalInitValue=0, ComSystemTemplateSystemSignalRef=FV_WhlRl_W_Meas
        FV_WhlFr_W_Meas_oWheelSpeed_FD3_oCAN00_b162a32d_Rx: ComBitPosition=22, ComBitSize=15, ComSignalEndianness=BIG_ENDIAN, ComSignalInitValue=0, ComSystemTemplateSystemSignalRef=FV_WhlFr_W_Meas
        FV_LatCtlCpbltyDStat_No_Cnt_oLAst_D3_oCAN00_560d175e_Tx: ComBitPosition=37, ComBitSize=4, ComSignalEndianness=BIG_ENDIAN, ComSignalInitValue=0, ComTransferProperty=PENDING, ComSystemTemplateSystemSignalRef=FV_LatCtlCpbltyDStat_No_Cnt
        FV_TrlrAn_An_TrgtCalc_oLAst_D3_oCAN00_899ff7ff_Tx: ComBitPosition=31, ComBitSize=8, ComSignalEndianness=BIG_ENDIAN, ComSignalInitValue=0, ComTransferProperty=PENDING, ComSystemTemplateSystemSignalRef=FV_TrlrAn_An_TrgtCalc
        FV_VehLat2_A_Actl_oAccel_Data_oCAN00_8d12d287_Rx: ComBitPosition=4, ComBitSize=13, ComSignalEndianness=BIG_ENDIAN, ComSignalInitValue=0, ComSystemTemplateSystemSignalRef=FV_VehLat2_A_Actl
        FV_EAC_CANValid_oEAC_Request_oCAN00_83d58ed2_Rx: ComBitPosition=31, ComBitSize=8, ComSignalEndianness=BIG_ENDIAN, ComSignalInitValue=0, ComSystemTemplateSystemSignalRef=FV_EAC_CANValid
        FV_LsmcBrkDecelEnbl_D_Rq_oLAst_D3_oCAN00_caa26530_Tx: ComBitPosition=1, ComBitSize=2, ComSignalEndianness=BIG_ENDIAN, ComSignalInitValue=0, ComTransferProperty=PENDING, ComSystemTemplateSystemSignalRef=FV_LsmcBrkDecelEnbl_D_Rq
        FV_SAPPAngleControlStat4_oEPAS_INFO_oCAN00_3d7ddb29_Tx: ComBitPosition=13, ComBitSize=1, ComSignalEndianness=BIG_ENDIAN, ComSignalInitValue=0, ComTransferProperty=PENDING, ComSystemTemplateSystemSignalRef=FV_SAPPAngleControlStat4
        FV_SteMdule_I_Est_oEPAS_INFO_oCAN00_b5bdb270_Tx: ComBitPosition=21, ComBitSize=12, ComSignalEndianness=BIG_ENDIAN, ComSignalInitValue=0, ComTransferProperty=PENDING, ComSystemTemplateSystemSignalRef=FV_SteMdule_I_Est
        SteEffort_D_Stat_oEPAS_INFO_oCAN00_46a7a24d_Tx: ComBitPosition=52, ComBitSize=3, ComSignalEndianness=BIG_ENDIAN, ComSignalInitValue=0, ComTransferProperty=PENDING, ComSystemTemplateSystemSignalRef=SteEffort_D_Stat
        FV_WhlFl_W_Meas_oWheelSpeed_FD3_oCAN00_0e731a53_Rx: ComBitPosition=6, ComBitSize=15, ComSignalEndianness=BIG_ENDIAN, ComSignalInitValue=0, ComSystemTemplateSystemSignalRef=FV_WhlFl_W_Meas
    ComGeneral:
      ComConfigurationUseDet = false
      ComSafeBswChecks = false
      ComEnableSignalGroupArrayApi = false
      ComRetryFailedTransmitRequests = false
      ComSupportedIPduGroups = 2
      ComVersionInfoApi = false
      ComAdvancedIPduCallouts = true
      ComOptimizedIPduGroupHandling = true
      ComMetaDataSupport = false
      ComDeferredEventCacheSupport = false
      ComDescriptionGateway = false
      ComDescriptionRoutingCodeGeneration = false
      ComStrictRepetitionPeriod = false
      ComMixedModePeriodicSuppression = false
      ComSignalGateway = NONE
      ComEnableMDTForCyclicTransmission = true
      ComUserCbkHeaderFile = ComStack_App.h
      ComUserCbkHeaderFile = Stub_Com.h
